## boards/shields/aline30/Kconfig.shield
```kconfig
# Copyright (c) 2020 Pete Johanson
# SPDX-License-Identifier: MIT

config SHIELD_aline30_LEFT
	def_bool $(shields_list_contains,aline30_left)

config SHIELD_aline30_RIGHT
	def_bool $(shields_list_contains,aline30_right)
```
